## Kconfig
```kconfig
menuconfig MAVWRAP
	bool "MAVLink Wrapper"
	help
	  Enable MAVLink communication wrapper with support for
	  multiple transport types (UART, UDP network).

if MAVWRAP

config MAVWRAP_LOG_LEVEL
	int "MAVLink Wrapper Log Level"
	default 3
	range 0 4
	help
	  Log level for MAVLink wrapper driver:
	    0 = OFF
	    1 = ERROR
	    2 = WARNING
	    3 = INFO
	    4 = DEBUG

config MAVWRAP_TRANSPORT_UART
	bool "UART Transport Support"
	depends on SERIAL
	help
	  Enable UART transport for MAVLink communication.

config MAVWRAP_TRANSPORT_NETIF
	bool "Network Transport Support"
	depends on NETWORKING
	select NET_CONTEXT
	select NET_SOCKETS
	select NET_IPV4
	select NET_UDP
	help
	  Enable network transport for MAVLink communication.

config MAVWRAP_RX_STACK_SIZE
	int "RX Thread Stack Size"
	default 2048
	range 1024 8192
	help
	  Stack size for the MAVLink RX parsing thread.
	  Increase if you experience stack overflows.

config MAVWRAP_RX_THREAD_PRIORITY
	int "RX Thread Priority"
	default 5
	range 1 99
	help
	  Priority for the MAVLink RX parsing thread.
	  Lower values = higher priority.

config MAVWRAP_RX_RING_SIZE
	int "RX Ring Buffer Size"
	default 1024
	range 256 4096
	help
	  Size of the RX ring buffer in bytes.
	  Increase if you experience buffer overflows with high-rate messages.

config MAVWRAP_UART_DMA_RX_BUF_SIZE
	int "UART DMA RX Buffer Size"
	default 512
	range 128 2048
	depends on MAVWRAP_TRANSPORT_UART && UART_ASYNC_API
	help
	  Size of each UART DMA RX buffer (double buffered).

if MAVWRAP_TRANSPORT_UART

config MAVWRAP_UART_TX_TIMEOUT_MS
	int "UART TX Timeout (ms)"
	default 1000
	range 100 5000
	help
	  Timeout in milliseconds for UART transmission.
	  Applies to both DMA and IRQ modes.

config MAVWRAP_UART_RX_TIMEOUT_MS
	int "UART RX Timeout (ms)"
	default 100
	range 10 1000
	depends on UART_ASYNC_API
	help
	  Timeout in milliseconds for UART async RX mode.
	  Used for flushing partial packets.

config MAVWRAP_UART_IRQ_RX_BUF_SIZE
	int "UART IRQ RX Buffer Size"
	default 32
	range 16 256
	help
	  Size of temporary RX buffer for UART IRQ mode.
	  Data is immediately copied to ring buffer.
	  Larger values may improve performance on high baud rates.

endif # MAVWRAP_TRANSPORT_UART

config MAVWRAP_TX_THREAD
	bool "TX Thread"
	help
	  Use a dedicated thread for sending MAVLink messages.
	  When enabled, mavwrap_send_message() enqueues the message
	  and returns immediately (non-blocking).

if MAVWRAP_TX_THREAD

config MAVWRAP_TX_QUEUE_SIZE
	int "TX Queue Depth"
	default 4
	range 2 16
	help
	  Number of messages that can be queued for transmission.
	  If the queue is full, the message is dropped.

config MAVWRAP_TX_STACK_SIZE
	int "TX Thread Stack Size"
	default 2048
	range 1024 4096
	help
	  Stack size for the MAVLink TX thread.
	  Network transports (UDP) require at least 2048 bytes.

config MAVWRAP_TX_THREAD_PRIORITY
	int "TX Thread Priority"
	default 6
	range 1 99
	help
	  Priority for the MAVLink TX thread.
	  Lower values = higher priority.

endif # MAVWRAP_TX_THREAD

config MAVWRAP_INIT_PRIORITY
	int "Initialization Priority"
	default 80
	range 1 99
	help
	  Initialization priority for MAVLink wrapper devices.
	  Must be initialized after network subsystem.

if MAVWRAP_TRANSPORT_NETIF

config MAVWRAP_NETIF_CONNECT_TIMEOUT_MS
	int "Network Connection Timeout (ms)"
	default 5000
	range 1000 30000
	help
	  Timeout in milliseconds for network connection and DHCP.
	  Increase if your network takes longer to initialize.

config MAVWRAP_NETIF_SEND_TIMEOUT_MS
	int "Network Send Timeout (ms)"
	default 1000
	range 100 5000
	help
	  Timeout in milliseconds for sending packets over network.

endif # MAVWRAP_TRANSPORT_NETIF

endif # MAVWRAP
```

## dts/bindings/mavlink-wrapper.yaml
```yaml
# MAVLink Wrapper Devicetree Bindings

description: |
  MAVLink communication wrapper for Zephyr RTOS.

compatible: "mavlink-wrapper"

properties:
  label:
    type: string
    description: |
      Human-readable label for this MAVLink instance.
      Used in logs and shell commands.
      Example: "GCS", "Telemetry", "Companion"
  
  transport:
    type: phandle
    required: true
    description: |
      Reference to the transport interface used by this MAVLink instance.
      This should point to a UART or network device.

  serial-interface:
    type: boolean
    description: |
      Indicates if this MAVLink instance uses a serial interface (UART).
      Mutually exclusive with net-interface.

  net-interface:
    type: boolean
    description: |
      Indicates if this MAVLink instance uses network transport.
      If true, network configuration properties are required.
      Mutually exclusive with serial-interface.

  net-type:
    type: string
    required: false
    enum:
      - "udp"
    description: |
      Network transport protocol type.

  use-dhcp:
    type: boolean
    description: |
      If true, enables DHCP for this MAVLink network interface.
      If false, static IP configuration (local-ip) must be provided.
      Default: false

  local-ip:
    type: string
    description: |
      Local IP address (IPv4) for network transport.
      Required if use-dhcp is false.
      Example: "192.168.1.100"
      Default: "0.0.0.0"

  local-port:
    type: int
    default: 14550
    description: |
      Local port for network transport (bind port).
      For UDP: the port to listen on.
      Default: 14550

  remote-ip:
    type: string
    default: "0.0.0.0"
    description: |
      Remote IP address (IPv4) for network transport.
      For UDP: the destination IP for sent packets.
      Example: "192.168.1.1"
      Default: "0.0.0.0"

  remote-port:
    type: int
    default: 14551
    description: |
      Remote port for network transport.
      For UDP: the destination port for sent packets.
      Default: 14551
```
